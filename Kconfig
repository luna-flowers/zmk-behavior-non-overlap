## Kconfig
```kconfig
# Copyright (c) 2023 The ZMK Contributors
# SPDX-License-Identifier: MIT

config ZMK_BEHAVIOR_NON_OVERLAP
    bool
    default y
    depends on DT_HAS_ZMK_BEHAVIOR_NON_OVERLAP_ENABLED
```

## dts/bindings/zmk,behavior-non-overlap.yaml
```yaml
# Copyright (c) 2024 The ZMK Contributors
# SPDX-License-Identifier: MIT

description: Non-overlap behavior

compatible: "zmk,behavior-non-overlap"

include: one_param.yaml

properties:
  bindings:
    type: phandles
    required: true
  resume-capacity:
    type: int
    description: Maximum number of keys can be resumed.
  no-resume:
    type: boolean
    description: |
      If set, no key will be resumed and the property `resume-capacity` is
      ignored. This is the same as `resume-capacity` being set to `<0>`.
```
